/**
 * @cliArgs --board "/ti/boards/MSP_EXP432P401R" --product "simplelink_msp432p4_sdk@3.40.01.02"
 * @versions {"tool":"1.9.0+2015","templates":null}
 */
const BOOSTXL_SHARP128 = scripting.addHardware("/ti/boards/boosterpacks/BOOSTXL-SHARP128");

/**
 * Import the modules used in this configuration.
 */
const Display  = scripting.addModule("/ti/display/Display");
const Display1 = Display.addInstance();
const GPIO     = scripting.addModule("/ti/drivers/GPIO");
const GPIO1    = GPIO.addInstance();
const I2C      = scripting.addModule("/ti/drivers/I2C", {}, false);
const I2C1     = I2C.addInstance();
const I2C2     = I2C.addInstance();
const RTOS     = scripting.addModule("/ti/drivers/RTOS");
const SD       = scripting.addModule("/ti/drivers/SD");
const SD1      = SD.addInstance();

/**
 * Write custom configuration values to the imported modules.
 */
Display1.$name      = "CONFIG_Display_0";
Display1.$hardware  = system.deviceData.board.components.XDS110UART;
Display1.uart.$name = "CONFIG_UART_0";

GPIO1.$hardware = system.deviceData.board.components.LED1_RED;
GPIO1.$name     = "CONFIG_GPIO_LED_0";

I2C1.$name              = "CONFIG_I2C_0";
I2C1.i2c.sdaPin.$assign = "boosterpack.10";
I2C1.i2c.sclPin.$assign = "boosterpack.9";

I2C2.$name              = "CONFIG_I2C_1";
I2C2.i2c.sdaPin.$assign = "boosterpack.38";
I2C2.i2c.sclPin.$assign = "boosterpack.34";

const Power                   = scripting.addModule("/ti/drivers/Power", {}, false);
Power.performanceLevel3.$name = "ti_drivers_power_PowerMSP432PerfLevels0";
Power.performanceLevel2.$name = "ti_drivers_power_PowerMSP432PerfLevels1";
Power.performanceLevel1.$name = "ti_drivers_power_PowerMSP432PerfLevels2";
Power.performanceLevel0.$name = "ti_drivers_power_PowerMSP432PerfLevels3";

RTOS.name = "NoRTOS";

SD1.useFatFS          = true;
SD1.$name             = "CONFIG_SDFatFS_0";
SD1.$hardware         = BOOSTXL_SHARP128.components.SD_CARD;
SD1.slaveSelect.$name = "CONFIG_GPIO_0";

const SPI       = scripting.addModule("/ti/drivers/SPI", {}, false);
const SPI1      = SPI.addInstance({}, false);
SPI1.$name      = "CONFIG_SPI_0";
SD1.spiInstance = SPI1;

/**
 * Pinmux solution for unlocked pins/peripherals. This ensures that minor changes to the automatic solver in a future
 * version of the tool will not impact the pinmux you originally saw.  These lines can be completely deleted in order to
 * re-solve from scratch.
 */
Display1.uart.uart.$suggestSolution          = "EUSCI_A0";
Display1.uart.uart.txPin.$suggestSolution    = "ball.7";
Display1.uart.uart.rxPin.$suggestSolution    = "ball.6";
GPIO1.gpioPin.$suggestSolution               = "ball.4";
I2C1.i2c.$suggestSolution                    = "EUSCI_B1";
I2C2.i2c.$suggestSolution                    = "EUSCI_B2";
RTOS.timer0.resource.$suggestSolution        = "Timer_A0";
SD1.slaveSelect.gpioPin.$suggestSolution     = "boosterpack.8";
SPI1.spi.$suggestSolution                    = "EUSCI_B0";
SPI1.spi.sclkPin.$suggestSolution            = "boosterpack.7";
SPI1.spi.misoPin.$suggestSolution            = "boosterpack.14";
SPI1.spi.mosiPin.$suggestSolution            = "boosterpack.15";
SPI1.spi.dmaRxChannel.$suggestSolution       = "DMA_CH1";
SPI1.spi.dmaTxChannel.$suggestSolution       = "DMA_CH0";
SPI1.spi.dmaInterruptNumber.$suggestSolution = "DMA_INT0";
